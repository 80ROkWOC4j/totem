## config/west.yml
```yaml
# Customized firmware sources are Git submodules; west owns only their dependencies.
# Dependency selection follows zmk/app/west.yml at the pinned ZMK baseline.
manifest:
  group-filter:
    - -optional
    - -babblesim
  remotes:
    - name: zmkfirmware
      url-base: https://github.com/zmkfirmware
  projects:
    - name: zephyr
      remote: zmkfirmware
      revision: dacab4875df72109b96cc8977547a0dc04875bcd
      clone-depth: 1
      import:
        name-blocklist:
          - ci-tools
          - hal_altera
          - hal_cypress
          - hal_infineon
          - hal_microchip
          - hal_nxp
          - hal_openisa
          - hal_silabs
          - hal_xtensa
          - hal_st
          - hal_ti
          - loramac-node
          - mcuboot
          - mcumgr
          - net-tools
          - openthread
          - edtt
          - trusted-firmware-m
    - name: nanopb
      remote: zmkfirmware
      revision: 8c60555d6277a0360c876bd85d491fc4fb0cd74a
      path: modules/lib/nanopb
    - name: zmk-studio-messages
      remote: zmkfirmware
      revision: 6cb4c283e76209d59c45fbcb218800cd19e9339d
      path: modules/msgs/zmk-studio-messages
  self:
    path: config
```

## firmware/host-names/Kconfig
```kconfig
config TOTEM_HOST_NAMES
    bool "TOTEM host names and on-keyboard alias editor"
    depends on ZMK_BLE && ZMK_SPLIT_ROLE_CENTRAL && SHIELD_DONGLE_DISPLAY && SETTINGS
    select BT_GATT_CLIENT
    help
      Read the host GAP Device Name when available and keep per-bond aliases.
      The modal editor uses the TOTEM 38-key physical layout.
```

## firmware/host-names/dts/bindings/behaviors/totem,host-name-editor.yaml
```yaml
description: Hold and release to edit the selected Bluetooth profile's alias
compatible: "totem,host-name-editor"
include: zero_param.yaml
```
