## config/boards/shields/totem/Kconfig.shield
```kconfig
# Copyright (c) 2020 The ZMK Contributors
# SPDX-License-Identifier: MIT

config SHIELD_TOTEM_LEFT
    def_bool $(shields_list_contains,totem_left)

config SHIELD_TOTEM_RIGHT
    def_bool $(shields_list_contains,totem_right)

config SHIELD_TOTEM_DONGLE_CENTRAL
    def_bool $(shields_list_contains,totem_dongle_central)

config SHIELD_TOTEM_DONGLE_LEFT
    def_bool $(shields_list_contains,totem_dongle_left)

config SHIELD_TOTEM_DONGLE_RIGHT
    def_bool $(shields_list_contains,totem_dongle_right)
```
